## boards/shields/keeb_right_test/Kconfig.defconfig
```kconfig
if SHIELD_KEEB_RIGHT_TEST

config ZMK_KEYBOARD_NAME
    default "keeb_right_test"

endif # SHIELD_KEEB_RIGHT_TEST
```

## boards/shields/keeb_right_test/Kconfig.shield
```kconfig
config SHIELD_KEEB_RIGHT_TEST
    def_bool $(shields_list_contains,keeb_right_test)
```

## boards/shields/osk54/Kconfig.defconfig
```kconfig
if SHIELD_OSK54_LEFT

config ZMK_KEYBOARD_NAME
    default "OSK54"

config ZMK_SPLIT_ROLE_CENTRAL
    default y

endif # SHIELD_OSK54_LEFT

if SHIELD_OSK54_LEFT || SHIELD_OSK54_RIGHT

config ZMK_SPLIT
    default y

endif # SHIELD_OSK54_LEFT || SHIELD_OSK54_RIGHT
```

## boards/shields/osk54/Kconfig.shield
```kconfig
config SHIELD_OSK54_LEFT
    def_bool $(shields_list_contains,osk54_left)

config SHIELD_OSK54_RIGHT
    def_bool $(shields_list_contains,osk54_right)
```
